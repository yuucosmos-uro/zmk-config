## boards/shields/flat/Kconfig.defconfig
```kconfig
if SHIELD_FLAT_LEFT

config ZMK_KEYBOARD_NAME
    default "flat"

config ZMK_SPLIT_ROLE_CENTRAL
    default y

endif

if SHIELD_FLAT_LEFT || SHIELD_FLAT_RIGHT

config ZMK_SPLIT
    default y

endif
```

## boards/shields/flat/Kconfig.shield
```kconfig
config SHIELD_FLAT_LEFT
    def_bool $(shields_list_contains,flat_left)

config SHIELD_FLAT_RIGHT
    def_bool $(shields_list_contains,flat_right)
```

## boards/shields/poco/Kconfig.shield
```kconfig
config SHIELD_POCO_LEFT
    def_bool $(shields_list_contains,POCO_left)

config SHIELD_POCO_RIGHT
    def_bool $(shields_list_contains,POCO_right)
```

## config/west.yml
```yaml
manifest:
  defaults:
    revision: main
  remotes:
    # - name: zmkfirmware
    #  url-base: https://github.com/zmkfirmware
    - name: cormoran
      url-base: https://github.com/cormoran
  projects:
    - name: zmk
      remote: cormoran
      revision: v0.3-branch+custom-studio-protocol+activity
      import:
        file: app/west.yml

    - name: zmk-module-ble-management
      remote: cormoran
      revision: 57738cc

    - name: zmk-module-battery-history
      remote: cormoran
      revision: 307755d

    - name: zmk-module-settings-rpc
      remote: cormoran
      revision: 78f86df

  self:
    path: config
```
